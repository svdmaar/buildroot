## configs/ekt_wpe_ml_defconfig
```kconfig
BR2_arm=y
BR2_cortex_a53=y
BR2_ARM_FPU_NEON_VFPV4=y
BR2_ARM_INSTRUCTIONS_THUMB2=y
BR2_CCACHE=y
BR2_OPTIMIZE_2=y
BR2_TOOLCHAIN_EXTERNAL=y
BR2_TOOLCHAIN_EXTERNAL_CUSTOM=y
BR2_TOOLCHAIN_EXTERNAL_PATH="/opt/toolchain/ekt/"
BR2_TOOLCHAIN_EXTERNAL_CUSTOM_PREFIX="arm-gcc49-linux-gnueabihf"
BR2_TOOLCHAIN_EXTERNAL_GCC_4_9=y
BR2_TOOLCHAIN_EXTERNAL_HEADERS_3_14=y
BR2_TOOLCHAIN_EXTERNAL_CUSTOM_GLIBC=y
BR2_TARGET_GENERIC_HOSTNAME="ekt"
BR2_TARGET_GENERIC_ISSUE="Welcome to EKT"
BR2_TARGET_GENERIC_CABUNDLE=y
BR2_ROOTFS_DEVICE_CREATION_STATIC=y
BR2_PACKAGE_BUSYBOX_SMP=y
BR2_PACKAGE_GSTREAMER1=y
BR2_PACKAGE_GST1_PLUGINS_BASE_PLUGIN_APP=y
BR2_PACKAGE_GST1_PLUGINS_BASE_PLUGIN_VIDEOCONVERT=y
BR2_PACKAGE_GST1_PLUGINS_BASE_PLUGIN_GIO=y
BR2_PACKAGE_GST1_PLUGINS_BASE_PLUGIN_OPUS=y
BR2_PACKAGE_GST1_PLUGINS_GOOD=y
BR2_PACKAGE_GST1_PLUGINS_GOOD_PLUGIN_AUDIOFX=y
BR2_PACKAGE_GST1_PLUGINS_GOOD_PLUGIN_AUDIOPARSERS=y
BR2_PACKAGE_GST1_PLUGINS_GOOD_PLUGIN_DEINTERLACE=y
BR2_PACKAGE_GST1_PLUGINS_GOOD_PLUGIN_FLV=y
BR2_PACKAGE_GST1_PLUGINS_GOOD_PLUGIN_INTERLEAVE=y
BR2_PACKAGE_GST1_PLUGINS_GOOD_PLUGIN_MATROSKA=y
BR2_PACKAGE_GST1_PLUGINS_GOOD_PLUGIN_SOUPHTTPSRC=y
BR2_PACKAGE_GST1_PLUGINS_BAD=y
BR2_PACKAGE_GST1_PLUGINS_BAD_PLUGIN_DEBUGUTILS=y
BR2_PACKAGE_GST1_PLUGINS_BAD_PLUGIN_MPEGTSDEMUX=y
BR2_PACKAGE_GST1_PLUGINS_BAD_PLUGIN_VIDEOPARSERS=y
BR2_PACKAGE_GST1_PLUGINS_BAD_PLUGIN_DASH=y
BR2_PACKAGE_GST1_PLUGINS_BAD_PLUGIN_FAAD=y
BR2_PACKAGE_GST1_PLUGINS_BAD_PLUGIN_HLS=y
BR2_PACKAGE_GST1_PLUGINS_BAD_PLUGIN_OPUS=y
BR2_PACKAGE_GST1_PLUGINS_BAD_PLUGIN_SMOOTHSTREAMING=y
BR2_PACKAGE_GST1_PLUGINS_UGLY=y
BR2_PACKAGE_GST1_PLUGINS_UGLY_PLUGIN_MPG123=y
BR2_PACKAGE_NINJA=y
BR2_PACKAGE_BITSTREAM_VERA=y
BR2_PACKAGE_XKEYBOARD_CONFIG=y
BR2_PACKAGE_LIBGCRYPT=y
BR2_PACKAGE_CAIRO=y
BR2_PACKAGE_CAIRO_PNG=y
BR2_PACKAGE_JPEG=y
BR2_PACKAGE_WPEFRAMEWORK=y
BR2_PACKAGE_WPEFRAMEWORK_PERSISTENT_PATH="/hdd/metrological/persistent"
BR2_PACKAGE_WPEFRAMEWORK_DATA_PATH="/hdd/metrological/usr/share/WPEFramework"
BR2_PACKAGE_WPEFRAMEWORK_SYSTEM_PATH="/hdd/metrological/usr/lib/wpeframework/plugins"
BR2_PACKAGE_WPEFRAMEWORK_PROXYSTUB_PATH="/hdd/metrological/usr/lib/wpeframework/proxystubs"
BR2_PACKAGE_WPEFRAMEWORK_VIRTUALINPUT=y
BR2_PACKAGE_WPEFRAMEWORK_LOCATIONSYNC=y
BR2_PACKAGE_WPEFRAMEWORK_MONITOR=y
BR2_PACKAGE_WPEFRAMEWORK_REMOTECONTROL=y
BR2_PACKAGE_WPEFRAMEWORK_TIMESYNC=y
BR2_PACKAGE_WPEFRAMEWORK_TRACECONTROL=y
BR2_PACKAGE_WPEFRAMEWORK_WEBSERVER=y
BR2_PACKAGE_WPEFRAMEWORK_WEBSHELL=y
BR2_PACKAGE_LIBXKBCOMMON=y
BR2_PACKAGE_LIBXSLT=y
BR2_PACKAGE_LIBSOUP_SSL=y
BR2_PACKAGE_ORC=y
BR2_PACKAGE_SHARED_MIME_INFO=y
BR2_PACKAGE_XUTIL_UTIL_MACROS=y
BR2_PACKAGE_UTIL_LINUX_PIVOT_ROOT=y
```

## package/acn-5202-sdk/Config.in
```kconfig
config BR2_PACKAGE_ACN_5202_SDK
	bool "acn-5202-sdk"
	depends on BR2_arm
	select BR2_PACKAGE_HAS_NEXUS_SAGE
	select BR2_PACKAGE_HAS_NEXUS
	select BR2_PACKAGE_HAS_LIBEGL
	select BR2_PACKAGE_HAS_LIBGLES
	select BR2_PACKAGE_HAS_PLAYREADY
        select BR2_PACKAGE_HAS_VP9_DECODER
	help
	  Pre-compiled binaries for a platform

if BR2_PACKAGE_ACN_5202_SDK

config BR2_PACKAGE_PROVIDES_NEXUS
	default "acn-5202-sdk"

config BR2_PACKAGE_PROVIDES_LIBEGL
	default "acn-5202-sdk"

config BR2_PACKAGE_PROVIDES_LIBGLES
	default "acn-5202-sdk"

config BR2_PACKAGE_PROVIDES_PLAYREADY
	default "acn-5202-sdk"

config BR2_PACKAGE_PROVIDES_VP9_DECODER
	default "acn-5202-sdk"

config BR2_PACKAGE_PROVIDES_NEXUS_SAGE
	default "acn-5202-sdk"

endif
```

## package/amazon-alexa/alexa-smart-screen-sdk/Config.in
```kconfig
menuconfig BR2_PACKAGE_ALEXA_SMART_SCREEN_SDK
    bool "alexa-smart-screen-sdk"
    select BR2_PACKAGE_APL_CORE_LIBRARY
    select BR2_PACKAGE_AVS_DEVICE_SDK
    select BR2_PACKAGE_WEBSOCKETPP
    select BR2_PACKAGE_ASIO
    help
        The Alexa Smart Screen SDK enables device makers to build screen-based products that
        complement Alexa voice responses with rich visuals.
        https://developer.amazon.com/alexa-voice-service/alexa-smart-screen-sdk


if BR2_PACKAGE_ALEXA_SMART_SCREEN_SDK
    config BR2_PACKAGE_ALEXA_SMART_SCREEN_SDK_ENABLE_JS_GUICLIENT
        bool "Enable JS GUIClient"
        default y
        help
            Builds the default GUIClient application

    if BR2_PACKAGE_ALEXA_SMART_SCREEN_SDK_ENABLE_JS_GUICLIENT
        config BR2_PACKAGE_ALEXA_SMART_SCREEN_SDK_JS_GUICLIENT_INSTALL_PATH
            string "GUIClient install path"
            default "/www/alexa"
            help
                The path on the target where GUIClient should be installed

    endif
endif
```

## package/amazon-alexa/avs-device-sdk/Config.in
```kconfig
menuconfig BR2_PACKAGE_AVS_DEVICE_SDK
    bool "avs-device-sdk"
    select BR2_PACKAGE_OPENSSL
    select BR2_PACKAGE_LIBCURL
    select BR2_PACKAGE_LIBCURL_ENABLE_HTTP2
    select BR2_PACKAGE_SQLITE
    help
        An SDK for commercial device makers to integrate Alexa directly into connected products.

if BR2_PACKAGE_AVS_DEVICE_SDK

choice BR2_PACKAGE_AVS_DEVICE_SDK_BUILD_TYPE
    prompt "Build type"
    default BR2_PACKAGE_AVS_DEVICE_SDK_BUILD_TYPE_DEBUG
    help
        Select build type

config BR2_PACKAGE_AVS_DEVICE_SDK_BUILD_TYPE_RELEASE
    bool "Release"
    help
        Release build

config BR2_PACKAGE_AVS_DEVICE_SDK_BUILD_TYPE_DEBUG
    bool "Debug"
    help
        Debug build

endchoice # BR2_PACKAGE_AVS_DEVICE_SDK_BUILD_TYPE

config BR2_PACKAGE_AVS_DEVICE_SDK_BUILD_GST_MEDIA_PLAYER
    bool "build gstreamer media player"
    select BR2_PACKAGE_GSTREAMER1
    select BR2_PACKAGE_GST1_PLUGINS_BASE
    select BR2_PACKAGE_GST1_PLUGINS_GOOD
    select BR2_PACKAGE_GST1_PLUGINS_BAD
    select BR2_PACKAGE_GST1_LIBAV
    help
        Build gstreamer media player

config BR2_PACKAGE_AVS_DEVICE_SDK_BUILD_SAMPLE_APP
    bool "build sample app"
    default n
    select BR2_PACKAGE_GSTREAMER1
    select BR2_PACKAGE_GST1_PLUGINS_BASE
    select BR2_PACKAGE_GST1_PLUGINS_GOOD
    select BR2_PACKAGE_GST1_PLUGINS_BAD
    select BR2_PACKAGE_GST1_LIBAV
    help
        Build the sample app

if BR2_PACKAGE_AVS_DEVICE_SDK_BUILD_SAMPLE_APP
choice BR2_PACKAGE_AVS_DEVICE_SDK_MICROPHONE_BACKEND
    prompt "Microphone backend"
    default BR2_PACKAGE_AVS_DEVICE_SDK_MICROPHONE_BACKEND_PORTAUDIO
    help
        Select the type of microphone backend.

config BR2_PACKAGE_AVS_DEVICE_SDK_MICROPHONE_BACKEND_PORTAUDIO
    bool "portaudio"
    select BR2_PACKAGE_PORTAUDIO
    help
        Use portaudio as the microphone backend.

endchoice # BR2_PACKAGE_AVS_DEVICE_SDK_MICROPHONE_BACKEND
endif # BR2_PACKAGE_AVS_DEVICE_SDK_BUILD_SAMPLE_APP

endif # BR2_PACKAGE_AVS_DEVICE_SDK
```

## package/ccspcommonlibrary/Config.in
```kconfig
config BR2_PACKAGE_CCSPCOMMONLIBRARY
    bool "parodus"
    default n
    select BR2_PACKAGE_DBUS
    help
       Ccsp common library
```

## package/parodus2ccsp/Config.in
```kconfig
config BR2_PACKAGE_PARODUS2CCSP
    bool "parodus2ccsp"
    default n
    select BR2_PACKAGE_LIBPARODUS
    select BR2_PACKAGE_CCSPCOMMONLIBRARY
    help
       parodus to ccsp library
```

## package/wpe/wpeframework-amazon/Config.in
```kconfig
menuconfig BR2_PACKAGE_WPEFRAMEWORK_AMAZON
	depends on BR2_PACKAGE_AMAZON
	bool "Amazon"
	help
	   WPE Platform plugins that supports amazon services.

if BR2_PACKAGE_WPEFRAMEWORK_AMAZON
# options for the plugin
menu "Options"
config BR2_PACKAGE_WPEFRAMEWORK_AMAZON_DTID
    help "DTID will be provided by amazon, test DTID's can be found in docs on the partner central")
	string "DTID"
	default "UnknownDTID"

config BR2_PACKAGE_WPEFRAMEWORK_AMAZON_MODEL
	string "model name"
	default "UnknownModel"

config BR2_PACKAGE_WPEFRAMEWORK_AMAZON_MANUFACTURER
	string "manufacturer"
	default "UnknownManufacturer"

config BR2_PACKAGE_WPEFRAMEWORK_AMAZON_CHIPSET
	string "chipset"
	default "UnknownChipset"

config BR2_PACKAGE_WPEFRAMEWORK_AMAZON_USER
    help "The user that amazon prime should use (root is not allowed)")
	string "user"

config BR2_PACKAGE_WPEFRAMEWORK_AMAZON_GROUP
    help "The group that amazon prime user should use (root is not allowed)")
	string "group"

config BR2_PACKAGE_WPEFRAMEWORK_AMAZON_CA_BUNDLE_PATH
    help "Path where ca-certitificats.cert is located)
	string "ca bundle path"

config BR2_PACKAGE_WPEFRAMEWORK_AMAZON_FRAGMENT_CACHE_SIZE
    help "Fragment cache size in MB)
	string "Fragment cache size (MB)"

endmenu
endif
```
